## misc.bf3/misc/bootsd.its
```
/dts-v1/;

/ {
	description = "bpi f3 kernel";
	#address-cells = <2>;

	images {
		kernel {
			description = "kernel";
			data = /incbin/("/compile/source/linux-bpi-bf3/arch/riscv/boot/Image");
			type = "kernel";
			arch = "riscv";
			os = "linux";
			compression = "none";
			load = <0x0 0x01400000>;
			entry = <0x0 0x01400000>;
			hash {
				algo = "crc32";
			};
		};
	};

	configurations {
		default = "conf-default";
		conf-default {
			description = "bpi f3 kernel";
			kernel = "kernel";
		};
	};
};
```
